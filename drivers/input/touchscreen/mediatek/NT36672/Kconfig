## drivers/input/touchscreen/mediatek/NT36672/Kconfig
```kconfig
#
# Novatek NT36672 touchscreen driver configuration
#
config TOUCHSCREEN_MTK_NT36672
	bool "Novatek NT36672 download driver"
	default n
	help
	  Say Y here if you have a Novatek NT36672 no flash touchscreen connected
	  to your system by SPI bus.

	  If unsure, say N.

config TOUCHSCREEN_MTK_NT36672_MP_CTRLRAM
	bool "Novatek NT36672 Multipoint Control RAM"
	depends on TOUCHSCREEN_MTK_NT36672
	default n
	help
	  Say Y here if you need to use Multipoint Control RAM Testing
	  If unsure, say N.
```
